## main/Kconfig.projbuild
```kconfig
menu "Configurações do Projeto"

    config LOW_POWER
        int "Low Power"
        default 0
        range 0 1
        help
            Modo da Esp 32

    config ESP_WIFI_SSID
        string "WiFi SSID"
        default "SSID"
        help
            Nome da rede Wifi.

    config ESP_WIFI_PASSWORD
        string "Senha do Wifi"
        default "PASS"
        help
            Senha do WiFi (WPA ou WPA2).

    config ESP_MAXIMUM_RETRY
        int "Número máximo de tentativas de conexão"
        default 5
        help
            Configure o valor máximo de tentativas de conexão

endmenu
```
